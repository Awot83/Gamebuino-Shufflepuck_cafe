//imports the SPI library (needed to communicate with Gamebuino's screen)
#include <SPI.h>
//imports the Gamebuino library
#include <Gamebuino.h>
//creates a Gamebuino object named gb
Gamebuino gb;

//v0.9 03/03/2017
// TODO :
// ajout de sons ?
// ajout de musique ?

int x = 0;
int y = 0;
int StatAnim = 0;


const byte intro[] PROGMEM = {64,36,B00010000,B00000101,B00000100,B00000000,B00000000,B00000000,B00000000,B01001001,B00100000,B00001010,B00001000,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B11011010,};
const byte bar[] PROGMEM = {88,48,0xFF,0xFF,0xFF,0xFF,0xFF,0xFF,0xFA,0x38,0xE3,0x8E,0x30,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0x10,};
const byte bar2[] PROGMEM = {88,48,0xFF,0xFF,0xFF,0xFF,0xFF,0xFF,0xFA,0x38,0xE3,0x8E,0x30,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0x10,};
const byte bar3[] PROGMEM = {88,48,0xFF,0xFF,0xFF,0xFF,0xFF,0xFF,0xFA,0x38,0xE3,0x8E,0x30,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0x10,};

const byte bejin[] PROGMEM = {88,48,0xFF,0xFF,0xFF,0xFF,0xFF,0xFA,0x3F,0xFF,0xFF,0xFF,0xFF,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0x80,};
const byte bejin2[] PROGMEM = {88,48,0xFF,0xFF,0xFF,0xFF,0xFF,0xFA,0x3F,0xFF,0xFF,0xFF,0xFF,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0x80,};
const byte bejin3[] PROGMEM = {88,48,0xFF,0xFF,0xFF,0xFF,0xFF,0xFA,0x3F,0xFF,0xFF,0xFF,0xFF,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0x80,};
const byte biff[] PROGMEM = {88,48,0xFF,0xFF,0xFF,0xFF,0xFF,0xFF,0xFF,0xFF,0xFF,0xFF,0xFF,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0x80,};
const byte biff2[] PROGMEM = {88,48,0xFF,0xFF,0xFF,0xFF,0xFF,0xFF,0xFF,0xFF,0xFF,0xFF,0xFF,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0x80,};
const byte biff3[] PROGMEM = {88,48,0xFF,0xFF,0xFF,0xFF,0xFF,0xFF,0xFF,0xFF,0xFF,0xFF,0xFF,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0x80,};
const byte lexan[] PROGMEM = {88,48,0xFF,0xFF,0xFF,0xFF,0xFF,0xF0,0x0,0x1F,0xFF,0xFF,0xFF,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0x80,};
const byte lexan2[] PROGMEM = {88,48,0xFF,0xFF,0xFF,0xFF,0xFF,0xF0,0x0,0x1F,0xFF,0xFF,0xFF,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0x80,};
const byte lexan3[] PROGMEM = {88,48,0xFF,0xFF,0xFF,0xFF,0xFF,0xF0,0x0,0x1F,0xFF,0xFF,0xFF,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0x80,};
const byte nerual[] PROGMEM = {88,48,0xFF,0xFF,0xFF,0xFF,0xFF,0xFF,0x7D,0xFF,0xFF,0xFF,0xFF,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0x80,};
const byte nerual2[] PROGMEM = {88,48,0xFF,0xFF,0xFF,0xFF,0xFF,0xFF,0x7D,0xFF,0xFF,0xFF,0xFF,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0x80,};
const byte nerual3[] PROGMEM = {88,48,0xFF,0xFF,0xFF,0xFF,0xFF,0xFF,0x7D,0xFF,0xFF,0xFF,0xFF,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0x80,};
const byte visine[] PROGMEM = {88,48,0xFF,0xFF,0xFF,0xFF,0xFF,0xFF,0xFF,0xFF,0xFF,0xFF,0xFF,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0x80,};
const byte visine2[] PROGMEM = {88,48,0xFF,0xFF,0xFF,0xFF,0xFF,0xFF,0xFF,0xFF,0xFF,0xFF,0xFF,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0x80,};
const byte visine3[] PROGMEM = {88,48,0xFF,0xFF,0xFF,0xFF,0xFF,0xFF,0xFF,0xFF,0xFF,0xFF,0xFF,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0x80,};

#define NUM_SPRITES 3
const byte* BIFF[NUM_SPRITES] = {
  biff, //0
  biff2, //1
  biff3, //2
};

#define NUM_SPRITES 3
const byte* NERUAL[NUM_SPRITES] = {
  nerual, //0
  nerual2, //1
  nerual3, //2
};

#define NUM_SPRITES 3
const byte* VISINE[NUM_SPRITES] = {
  visine, //0
  visine2, //1
  visine3, //2
};

#define NUM_SPRITES 3
const byte* BAR[NUM_SPRITES] = {
  bar, //0
  bar2, //1
  bar3, //2
};


#define NUM_SPRITES 3
const byte* BEJIN[NUM_SPRITES] = {
  bejin, //0
  bejin2, //1
  bejin3, //2
};

#define NUM_SPRITES 3
const byte* LEXAN[NUM_SPRITES] = {
  lexan, //0
  lexan2, //1
  lexan3, //2
};

// the setup routine runs once when Gamebuino starts up
void setup() {

  // initialize the Gamebuino object
  gb.begin();
  mainMenu();

  //display the main menu:
}

void mainMenu() {
  gb.titleScreen(F(""), intro);
  gb.pickRandomSeed();
  gb.battery.show = false;
}

// the loop routine runs over and over again forever
void loop() {
  if (gb.update()) {

    // exit game
    if (gb.buttons.pressed(BTN_C)) {
      setup();
    }

//Dessins et animations
    switch (x) {
      case 0 :
        gb.display.drawBitmap(0, 0, BAR[StatAnim]);
        break;

      case 1 :
        gb.display.drawBitmap(0, 0, NERUAL[StatAnim]);

        break;

      case 2 :
        gb.display.drawBitmap(0, 0, LEXAN[StatAnim]);
        break;

      case 3 :
        gb.display.drawBitmap(0, 0, VISINE[StatAnim]);
        break;

      case 4 :
        gb.display.drawBitmap(0, 0, BIFF[StatAnim]);
        break;

       case 5 :
        gb.display.drawBitmap(0, 0, BEJIN[StatAnim]);
        break;
    }


    // Frequence des modif de l'animation
    y = y+1;
   if (y < 15) {StatAnim = 0;}
   if (y > 30 && y < 45){StatAnim = 1;}
   if (y > 45 && y < 60) {StatAnim = 2;}
   if (y > 60) {y=0;}


    // controle du changement d'animation manuelle
    if (gb.buttons.pressed(BTN_A)) {
      StatAnim++;
      if(StatAnim==1){y=31;}
      if(StatAnim==2){y=46;}
      if(StatAnim==3){y=0;}
              
      if (StatAnim < 0) {
        StatAnim = 0;
      }
      if (StatAnim > 2) {
        StatAnim = 2;
      }
    }

    // Controle : changement de personnage

    if (gb.buttons.pressed(BTN_RIGHT)) {
      x++;
      y=0;  //reset animation to 1rst
      if (x > 5) {
        x = 5;
      }
    }
    if (gb.buttons.pressed(BTN_LEFT)) {
      x--;
      y=0;  //reset animation to 1rst
      if (x < 1) {
        x = 1;
      }
    }

    if (gb.buttons.pressed(BTN_B)) {   // press B pour retourner au bar
      x = 0;
     y=0;  //reset animation to 1rst
    }



  }
}





